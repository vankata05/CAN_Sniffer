/*@!Encoding:1252*/
includes
{
  
}

variables
{
  message 0x7e8 diagnostic_response_msg;
}


on message *
{
  if (this.id == 0x7df)
  {
    write("Diagnostic request received!");
    
    diagnostic_response_msg.dlc = 8;
    
    diagnostic_response_msg.byte(1) = 0x41;
    diagnostic_response_msg.byte(2) = this.byte(2);
    
    switch(this.byte(2)){
      case 0x00:
        diagnostic_response_msg.byte(0) = 0x06;
        diagnostic_response_msg.byte(3) = 0x98;
        diagnostic_response_msg.byte(4) = 0x3B;
        diagnostic_response_msg.byte(5) = 0x00;
        diagnostic_response_msg.byte(6) = 0x17;
        diagnostic_response_msg.byte(7) = 0xAA;
        break;
      case 0x04:
        diagnostic_response_msg.byte(0) = 0x03;
        diagnostic_response_msg.byte(3) = 0x12;
        diagnostic_response_msg.byte(4) = 0xAA;
        diagnostic_response_msg.byte(5) = 0xAA;
        diagnostic_response_msg.byte(6) = 0xAA;
        diagnostic_response_msg.byte(7) = 0xAA;
        break;
      case 0x05:
        diagnostic_response_msg.byte(0) = 0x03;
        diagnostic_response_msg.byte(3) = 0x12;
        diagnostic_response_msg.byte(4) = 0xAA;
        diagnostic_response_msg.byte(5) = 0xAA;
        diagnostic_response_msg.byte(6) = 0xAA;
        diagnostic_response_msg.byte(7) = 0xAA;
        break;
      case 0x0B:
        diagnostic_response_msg.byte(0) = 0x03;
        diagnostic_response_msg.byte(3) = 0x12;
        diagnostic_response_msg.byte(4) = 0xAA;
        diagnostic_response_msg.byte(5) = 0xAA;
        diagnostic_response_msg.byte(6) = 0xAA;
        diagnostic_response_msg.byte(7) = 0xAA;
        break;
      case 0x0C:
        diagnostic_response_msg.byte(0) = 0x04;
        diagnostic_response_msg.byte(3) = 0x12;
        diagnostic_response_msg.byte(4) = 0x34;
        diagnostic_response_msg.byte(5) = 0xAA;
        diagnostic_response_msg.byte(6) = 0xAA;
        diagnostic_response_msg.byte(7) = 0xAA;
        break;
      case 0x0D:
        diagnostic_response_msg.byte(0) = 0x03;
        diagnostic_response_msg.byte(3) = 0x12;
        diagnostic_response_msg.byte(4) = 0xAA;
        diagnostic_response_msg.byte(5) = 0xAA;
        diagnostic_response_msg.byte(6) = 0xAA;
        diagnostic_response_msg.byte(7) = 0xAA;
        break;
      case 0x0F:
        diagnostic_response_msg.byte(0) = 0x03;
        diagnostic_response_msg.byte(3) = 0x12;
        diagnostic_response_msg.byte(4) = 0xAA;
        diagnostic_response_msg.byte(5) = 0xAA;
        diagnostic_response_msg.byte(6) = 0xAA;
        diagnostic_response_msg.byte(7) = 0xAA;
        break;
      case 0x21:
        diagnostic_response_msg.byte(0) = 0x04;
        diagnostic_response_msg.byte(3) = 0x12;
        diagnostic_response_msg.byte(4) = 0x34;
        diagnostic_response_msg.byte(5) = 0xAA;
        diagnostic_response_msg.byte(6) = 0xAA;
        diagnostic_response_msg.byte(7) = 0xAA;
        break;
      case 0x2F:
        diagnostic_response_msg.byte(0) = 0x03;
        diagnostic_response_msg.byte(3) = 0x12;
        diagnostic_response_msg.byte(4) = 0xAA;
        diagnostic_response_msg.byte(5) = 0xAA;
        diagnostic_response_msg.byte(6) = 0xAA;
        diagnostic_response_msg.byte(7) = 0xAA;
        break;
      case 0x42:
        diagnostic_response_msg.byte(0) = 0x04;
        diagnostic_response_msg.byte(3) = 0x12;
        diagnostic_response_msg.byte(4) = 0x34;
        diagnostic_response_msg.byte(5) = 0xAA;
        diagnostic_response_msg.byte(6) = 0xAA;
        diagnostic_response_msg.byte(7) = 0xAA;
        break;
      case 0x49:
        diagnostic_response_msg.byte(0) = 0x03;
        diagnostic_response_msg.byte(3) = 0x12;
        diagnostic_response_msg.byte(4) = 0xAA;
        diagnostic_response_msg.byte(5) = 0xAA;
        diagnostic_response_msg.byte(6) = 0xAA;
        diagnostic_response_msg.byte(7) = 0xAA;
        break;
        
        default:
        break;
    }
    
    output(diagnostic_response_msg);
      
  }
}
